/*
 *  colleges.h - 五院關卡資料
 *  =============================================================
 *  各院的:
 *    - 學院名稱 / 皮克敏名稱 / 圖示
 *    - 地點謎題(LoRa 觸發後顯示)
 *    - 節點任務說明(玩家找到節點後看到)
 *    - 通關訊息(捕獲後皮克敏的話)
 *
 *  ⚠️ 此檔內容專注於「資料」,不放邏輯
 *  ⚠️ 通關驗證邏輯在 task_verification.h
 */

#ifndef COLLEGES_H
#define COLLEGES_H

#include <Arduino.h>

struct College {
    const char* code;          // MGT / SCI / HUM / ENG / LAW
    const char* name;          // 顯示名(管理學院)
    const char* pikminName;    // 紫皮克敏 / 黃皮克敏...
    const char* emoji;         // 💼🔬📚🔧⚖️
    const char* locationHint;  // 地點謎題(LoRa 觸發後顯示)
    const char* questDesc;     // 節點任務說明(玩家找到後看到)
    const char* successMsg;    // 通關訊息
};

const College COLLEGES[] = {
    // ====================================================
    // 管理學院 — 紫皮克敏(YOLO person + LoRa RSSI 雙重驗證)
    // ====================================================
    {
        "MGT", "管理學院", "紫皮克敏", "💼",
        // 地點謎題
        "🌀 紫皮克敏的留言:\n\n"
        "「我不喜歡電梯,裡面太擠;\n"
        "也不喜歡一般樓梯,太單調。\n\n"
        "我喜歡那種——走著走著,\n"
        "眼前的風景會跟著我一起轉的地方。」",
        // 節點任務說明
        "📷 任務:站在旋轉樓梯前自拍一張!\n\n"
        "規則:\n"
        "  • 你必須在節點旁邊(訊號強度要 ≥ -50 dBm)\n"
        "  • 畫面裡要有「人」\n"
        "  • 兩個條件都通過才算\n\n"
        "→ 站好,看著鏡頭,按下「捕獲!」",
        // 通關訊息
        "「不錯,你找到了!360 度的視野,就是我選擇的理由。\n"
        "領導者要看得遠——你已經跨出了第一步。」"
    },

    // ====================================================
    // 理學院 — 黃皮克敏(YOLO potted plant)
    // ====================================================
    {
        "SCI", "理學院", "黃皮克敏", "🔬",
        "⚗️ 黃皮克敏的留言:\n\n"
        "「我選了個有點奇怪的地方——\n\n"
        "想想看:\n"
        "  • 水通常在哪裡?(地上)\n"
        "  • 池塘通常在哪裡?(戶外)\n"
        "  • 地下通常什麼樣?(密閉)\n\n"
        "我躲的地方,這三件事剛好都相反。」",

        "📷 任務:拍下一株植物(水生植物 / 盆栽 / 花草)\n\n"
        "提示:\n"
        "  • 池塘旁邊一定有水生植物\n"
        "  • AI 會自動辨識「植物」類別\n"
        "  • 拍清楚一點\n\n"
        "→ 對準植物,按下「捕獲!」",

        "「答對了。這個池塘違反三個常識,但科學就是質疑常識。\n"
        "你找對了——好的科學家會看見『不太對勁』的地方。」"
    },

    // ====================================================
    // 人文院 — 紅皮克敏(YOLO book)
    // ====================================================
    {
        "HUM", "人文院", "紅皮克敏", "📚",
        "📜 紅皮克敏的留言:\n\n"
        "「我留下了一個地名,用了五種語言:\n\n"
        "  🇹🇼 中庭\n"
        "  🇬🇧 Courtyard\n"
        "  🇯🇵 中庭(なかにわ)\n"
        "  🇰🇷 안마당\n"
        "  🇻🇳 Sân trong\n\n"
        "它們都指同一個地方。」",

        "📷 任務:拍下一本書\n\n"
        "提示:\n"
        "  • 中庭附近就是圖書館\n"
        "  • 任何一本書都可以\n"
        "  • 拍書封或書背都行\n\n"
        "→ 對準書,按下「捕獲!」",

        "「五種語言你都看懂了——\n"
        "人文,從來不是只看一面。\n"
        "知識的疆界,就是語言的疆界。」"
    },

    // ====================================================
    // 工學院 — 綠皮克敏(DHT22 濕度感測,不用視覺)
    // ====================================================
    {
        "ENG", "工學院", "綠皮克敏", "🔧",
        "🌬️ 綠皮克敏的留言:\n\n"
        "「教授,我頂樓風好大...\n\n"
        "別誤會,我只是上來吹風想開作業——\n"
        "又沒有要做什麼蠢事。\n\n"
        "提示:\n"
        "  • 我在工院最高樓層\n"
        "  • 我不在室內\n"
        "  • 我在最能感受風的地方」",

        "💨 任務:對著節點吹氣!\n\n"
        "規則:\n"
        "  • 走到節點旁\n"
        "  • 對著節點上的感測器吹氣\n"
        "  • 濕度達到 80% 即可通關\n\n"
        "目前濕度: 即時顯示\n\n"
        "→ 用力吹!",

        "「OK 認證你了。\n"
        "寫程式累了就上頂樓重新開機——\n"
        "然後下樓繼續寫。」"
    },

    // ====================================================
    // 法學院 — 藍皮克敏(Template Matching → 自訓二分類)
    // ====================================================
    {
        "LAW", "法學院", "藍皮克敏", "⚖️",
        "📖 藍皮克敏的留言:\n\n"
        "「我躲在某間教室前,房號 = 一條民法條文編號。\n\n"
        "案例:小明授權小華買賣房屋(代理權),\n"
        "後來小明口頭撤回授權,但小華不知情,\n"
        "仍以小明名義簽約。\n"
        "賣家不知情且善意。\n\n"
        "這條法律是民法第幾條?」",

        "📷 任務:拍下該教室的門牌\n\n"
        "提示:\n"
        "  • 民法 107 條:代理權之限制與撤回\n"
        "  • 走到 107 教室前\n"
        "  • 對準門牌號碼拍照\n"
        "  • AI 會驗證是否為正確門牌\n\n"
        "→ 對準門牌,按下「捕獲!」",

        "「107 條,代理權之限制與撤回。\n"
        "你會用工具——這就是法律人最重要的能力。\n"
        "法律不是死記,是活用。」"
    }
};

const int NUM_COLLEGES = 5;

// ====================================================
// Helper:從學院碼找資料
// ====================================================
inline const College* findCollege(const String& code) {
    for (int i = 0; i < NUM_COLLEGES; i++) {
        if (code == COLLEGES[i].code) return &COLLEGES[i];
    }
    return nullptr;
}

// ====================================================
// Helper:學院碼 → index (0-4)
// ====================================================
inline int collegeCodeToIdx(const String& code) {
    for (int i = 0; i < NUM_COLLEGES; i++) {
        if (code == COLLEGES[i].code) return i;
    }
    return -1;
}

#endif // COLLEGES_H
